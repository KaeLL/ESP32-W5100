## components/w5100/Kconfig
```kconfig
menu "W5100 configurations"
    menu "W5100 debug options"
        config W5100_DEBUG_TX
            bool "Dump data sent (TX)"
            help
                Dump data sent to the chip

        config W5100_DEBUG_RX
            bool "Dump data received (RX)"
            help
                Dump data received from the chip
    endmenu

    config EMAC_RECV_TASK_ENABLE_CORE_AFFINITY
        bool "Enable W5100 recv task core selection"
        default y
        help
            Enable this to manually set W5100's recv task affinity. May be needed
            in order to balance load across cores depending on workload.
            Leave it disabled for no affinity.

    config EMAC_RECV_TASK_CORE
        depends on EMAC_RECV_TASK_ENABLE_CORE_AFFINITY
        int "Which core?"
        range 0 1
        default 1
        help
            Select the core to pin the task to
            0 - PRO CPU
            1 - APP CPU

    config EMAC_RX_TASK_YIELD_TICKS
        int "RX task yield duration (ticks)"
        range 0 2147483647
        default 1
        help
            Amount of CPU ticks the RX task will yield after each run of its
            loop. Since the yield is performed by the ulTaskNotifyTake()
            function, this is also how long the task will wait for notifications
            from the EMAC. A value greater than 0 keeps the task from monopolizing
            CPU, which is especially useful in the presence of time-sensitive
            code or peripherals.
endmenu
```

## main/Kconfig.projbuild
```kconfig
menu "ESP32_W5100 configurations"
    config TZ_ENV
        string "TZ environment variable"
        default "GMT"
        help
            Manually set the TZ env_var. Defaults to GMT.

    config TEST_DEINIT
        bool "Enable deinit"

    config TEST_STATIC_IP
        bool "Enable static IP"
endmenu
```

## sdkconfig.defaults
```kconfig
CONFIG_APP_NO_BLOBS=y
CONFIG_BOOTLOADER_COMPILER_OPTIMIZATION_PERF=y
CONFIG_BOOTLOADER_LOG_LEVEL_NONE=y
CONFIG_BOOTLOADER_SKIP_VALIDATE_ALWAYS=y
CONFIG_ESPTOOLPY_FLASHMODE_QIO=y
CONFIG_ESPTOOLPY_FLASHFREQ_80M=y
CONFIG_ESPTOOLPY_FLASHSIZE_4MB=y
CONFIG_ESPTOOLPY_AFTER_NORESET=y
CONFIG_TZ_ENV="BRT+3"
CONFIG_COMPILER_WARN_WRITE_STRINGS=y
CONFIG_SPI_MASTER_IN_IRAM=y
# CONFIG_SPI_SLAVE_ISR_IN_IRAM is not set
CONFIG_GPIO_CTRL_FUNC_IN_IRAM=y
# CONFIG_GPTIMER_ISR_HANDLER_IN_IRAM is not set
# CONFIG_ETH_USE_SPI_ETHERNET is not set
# CONFIG_ESP_EVENT_POST_FROM_ISR is not set
CONFIG_ESP32_REV_MIN_1=y
# CONFIG_ESP_PHY_CALIBRATION_AND_DATA_STORAGE is not set
CONFIG_ESP_PHY_RF_CAL_NONE=y
CONFIG_ESP_DEFAULT_CPU_FREQ_MHZ_240=y
CONFIG_ESP_SYSTEM_ESP32_SRAM1_REGION_AS_IRAM=y
CONFIG_ESP_CONSOLE_UART_CUSTOM=y
CONFIG_ESP_CONSOLE_UART_BAUDRATE=921600
CONFIG_ESP_INT_WDT_TIMEOUT_MS=30
CONFIG_ESP_TASK_WDT_PANIC=y
CONFIG_ESP_TASK_WDT_TIMEOUT_S=3
# CONFIG_ESP_DEBUG_OCDAWARE is not set
CONFIG_ESP_BROWNOUT_DET_LVL_SEL_7=y
# CONFIG_ESP_WIFI_IRAM_OPT is not set
# CONFIG_ESP_WIFI_RX_IRAM_OPT is not set
CONFIG_ESP_COREDUMP_ENABLE_TO_UART=y
# CONFIG_ESP_COREDUMP_LOGS is not set
CONFIG_ESP_COREDUMP_MAX_TASKS_NUM=12
CONFIG_ESP_COREDUMP_STACK_SIZE=1024
# CONFIG_FREERTOS_TASK_FUNCTION_WRAPPER is not set
CONFIG_HEAP_ABORT_WHEN_ALLOCATION_FAILS=y
CONFIG_LOG_DEFAULT_LEVEL_DEBUG=y
CONFIG_LOG_TIMESTAMP_SOURCE_SYSTEM=y
CONFIG_LWIP_TCPIP_TASK_AFFINITY_CPU1=y
CONFIG_LWIP_DHCP_GET_NTP_SRV=y
CONFIG_MBEDTLS_TLS_CLIENT_ONLY=y
# CONFIG_MQTT_TRANSPORT_WEBSOCKET is not set
CONFIG_MQTT_SKIP_PUBLISH_IF_DISCONNECTED=y
CONFIG_MQTT_REPORT_DELETED_MESSAGES=y
```
